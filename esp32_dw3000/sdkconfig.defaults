## esp32_dw3000/sdkconfig.defaults
```kconfig
CONFIG_DW3000_GPIO_IRQ=34
CONFIG_DW3000_GPIO_RESET=27
CONFIG_DW3000_GPIO_WAKEUP=32
CONFIG_DW3000_SPI_MOSI=23
CONFIG_DW3000_SPI_MISO=19
CONFIG_DW3000_SPI_CLK=18
CONFIG_DW3000_SPI_CS=4
CONFIG_DW3000_SPI_MAX_MHZ=22
CONFIG_DW3000_CHIP_DW3000=y
```

## matouch/components/bsp/Kconfig.projbuild
```kconfig
menu "Board Configuration"

    config SPIFFS_ENABLE
        bool "Enable SPIFFS filesystem support"
        default n
        help
            Enable SPIFFS filesystem support
    
    config SDCARD_ENABLE
        bool "Enable SD Card support"
        default n
        help
            Enable SD Card support

    config AUDIO_ENABLE
        bool "Enable Audio Codec support"
        default n
        help
            Enable Audio Codec support

    config QMI8658_ENABLE
        bool "Enable QMI8658 Accelerometer support"
        default n
        help
            Enable QMI8658 Accelerometer support

    config PCF85063A_ENABLE
        bool "Enable PCF85063A RTC support"
        default n
        help
            Enable PCF85063A RTC support
    config PCF8563_ENABLE
        bool "Enable PCF8563 RTC support"
        default n
        help
            Enable PCF8563 RTC support

if SPIFFS_ENABLE
    config BSP_SPIFFS_FORMAT_ON_MOUNT_FAIL
        bool "Format SPIFFS if mount fails"
endif
if SDCARD_ENABLE
    config BSP_SDCARD_FORMAT_ON_MOUNT_FAIL
        bool "Format SDCARD if mount fails"
endif

endmenu
```

## matouch/main/Kconfig.projbuild
```kconfig
menu "Makerfabs Project"


choice BOARD_TYPE
    prompt "Board Type"
    default BOARD_TYPE_3_5_ili9488_ft6236
    help
        Board type. 开发板类型

    config BOARD_TYPE_3_5_ili9488_ft6236
        bool "3-5-ili9488-ft6236"
        depends on IDF_TARGET_ESP32S3
        select SDCARD_ENABLE
    config BOARD_TYPE_1_28_gc9a01_cst816s
        bool "1-28-gc9a01-cst816s"
        depends on IDF_TARGET_ESP32S3
        select PCF85063A_ENABLE
    config BOARD_TYPE_2_8_st7798v_gt911
        bool "2-8-st7798v-gt911"
        depends on IDF_TARGET_ESP32S3
endchoice

choice DEVELOPMENT_MODE
    prompt "Development Mode"
    default DEVELOPMENT_MODE_DEBUG
    help
        Development Mode

    config DEVELOPMENT_MODE_DEBUG
        bool "Debug"
    config DEVELOPMENT_MODE_RELEASE
        bool "Release"
endchoice


endmenu
```
